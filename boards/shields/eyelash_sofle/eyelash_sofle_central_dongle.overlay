
#include <dt-bindings/zmk/keys.h>
#include "eyelash_sofle.dtsi"

/ {
    chosen {
        zephyr,display = &st7789v;
        zephyr,buzzer = &buzzer;
        zephyr,backlight = &pwmbuzzer_backlight;  // <- unique label
        zmk,kscan = &mock_kscan;
        zmk,matrix-transform = &default_transform;
    };
};

/ {
    /* Mock kscan for testing */
    mock_kscan: kscan_0 {
        compatible = "zmk,kscan-mock";
        columns = <0>;
        rows = <0>;
        events = <0>;
    };
};

/* Backlight node - rename label to be unique */
pwmbuzzer: backlight {
    compatible = "pwm-backlight";
    pwms = <&pwm1 0 1000>;  // example PWM spec
    label = "pwmbuzzer_backlight";  // <- unique
    brightness-levels = <0 25 50 75 100>;
};

/* Optional LED node - give unique label if needed */
pwmleds {
    compatible = "pwm-leds";
    led1: led_1 {
        pwms = <&pwm2 0 500>;
        label = "pwmled1";
    };
};
